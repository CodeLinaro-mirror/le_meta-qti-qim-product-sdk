## conf/layer.conf
```bitbake
BBFILES += "${LAYERDIR}/recipes*/*/*.bb ${LAYERDIR}/recipes*/*/*.bbappend"
BBPATH .= ":${LAYERDIR}"
BBFILE_COLLECTIONS += "qti-qim-product-sdk"
BBFILE_PATTERN_qti-qim-product-sdk := "^${LAYERDIR}/"
BBFILE_PRIORITY_qti-qim-product-sdk = "7"
LAYERSERIES_COMPAT_qti-qim-product-sdk = "kirkstone scarthgap"

# add packagegroup-qcom-qim-product to the base image
CORE_IMAGE_EXTRA_INSTALL:append:qcom = " packagegroup-qcom-qim-product"
```
